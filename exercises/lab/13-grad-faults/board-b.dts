/dts-v1/;

/ {
	compatible = "acme,board-b";
	model = "ACME Board B Rev 2";

	#address-cells = <1>;
	#size-cells = <1>;

	serial@2000 {
		compatible = "acme,uart";
		reg = <0x2000 0x100>;
		clock-frequency = <115200>;
		status = "okay";
	};
};
