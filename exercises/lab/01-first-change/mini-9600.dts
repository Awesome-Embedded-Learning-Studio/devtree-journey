/dts-v1/;

/ {
	compatible = "edts,a_demo";        /* 字符串属性 */
	#address-cells = <1>;            /* 单个 u32 cell */
	#size-cells = <1>;

	serial@1000 {                    /* 带单元地址的子节点 */
		compatible = "acme,uart";
		reg = <0x1000 0x100>;    /* 两个 cell */
		clock-frequency = <9600>;
		status = "okay";
	};
};
