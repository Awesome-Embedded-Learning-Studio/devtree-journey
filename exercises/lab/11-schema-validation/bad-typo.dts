/dts-v1/;

/ {
	compatible = "acme,soc1000";
	model = "ACME Lab Board";

	#address-cells = <1>;
	#size-cells = <1>;

	serial@1000 {
		compatible = "acme,serail";
		reg = <0x1000 0x100>;
		clock-frequency = <115200>;
	};
};
