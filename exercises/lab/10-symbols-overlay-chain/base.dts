/dts-v1/;

/ {
	compatible = "acme,soc2000";
	model = "ACME Core Board";
	#address-cells = <1>;
	#size-cells = <1>;

	i2c0: i2c@800 {
		compatible = "acme,i2c";
		reg = <0x800 0x20>;
		#address-cells = <1>;
		#size-cells = <0>;
		status = "okay";
	};

	uart0: serial@1000 {
		compatible = "acme,uart";
		reg = <0x1000 0x100>;
		clock-frequency = <115200>;
		status = "okay";
	};
};
